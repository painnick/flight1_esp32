## sdkconfig.defaults
```kconfig
# 보드 설정 (ESP32-C3)
CONFIG_IDF_TARGET="esp32c3"

# CPU 클럭 주파수 (80MHz로 저전력 모드)
CONFIG_ESP_DEFAULT_CPU_FREQ_MHZ_80=y

# UART 콘솔 설정
CONFIG_ESP_CONSOLE_USB_SERIAL_JTAG=y
CONFIG_ESP_CONSOLE_SECONDARY_USB_SERIAL_JTAG=y
CONFIG_ESP_CONSOLE_UART_DEFAULT=USB_SERIAL_JTAG

# 로그 레벨
CONFIG_LOG_DEFAULT_LEVEL_INFO=y
CONFIG_LOG_MAXIMUM_LEVEL_DEBUG=y

# FreeRTOS 설정
CONFIG_FREERTOS_HZ=1000

# WiFi/BT 비활성화 (기본값이지만 명시적 비활성화)
CONFIG_ESP_WIFI_ENABLED=n
CONFIG_BT_ENABLED=n

# 파워 관리 (저전력 모드)
CONFIG_PM_ENABLE=y
CONFIG_PM_DFS_INIT_AUTO=y
CONFIG_PM DFS_AUTO=y
```
